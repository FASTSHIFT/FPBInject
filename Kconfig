## Kconfig
```kconfig
#
# For a description of the syntax of this configuration file,
# see the file kconfig-language.txt in the NuttX tools repository.
#

menuconfig FPBINJECT
	tristate "FPBInject - Cortex-M FPB Runtime Injection Tool"
	default n
	---help---
		Enable FPBInject function loader. This is a runtime code injection
		tool using ARM Cortex-M Flash Patch and Breakpoint (FPB) unit.
		It allows dynamic function patching and redirection at runtime.

if FPBINJECT

config FPBINJECT_PRIORITY
	int "FPBInject task priority"
	default 110

config FPBINJECT_STACKSIZE
	int "FPBInject stack size"
	default 8192

config FPBINJECT_BUF_SIZE
	int "Static code buffer size"
	default -1
	---help---
		Size of the static buffer used for code injection.
		This buffer is used to store injected code.
		Set to -1 to use the dynamic buffer allocation.

config FPBINJECT_LINE_SIZE
	int "Command line buffer size"
	default 1024
	---help---
		Size of the command line input buffer for interactive mode.

config FPBINJECT_EXEC_INHERIT_PRIORITY
	bool "exec: run commands at the priority of the fl task"
	default y
	depends on NSH_LIBRARY && SCHED_WAITPID && !BUILD_KERNEL
	---help---
		Run the exec shell task at the priority of the fl task. When off,
		exec uses system() (needs SYSTEM_SYSTEM).

config FPBINJECT_EXEC_STACKSIZE
	int "Stack size of the exec shell task"
	default 4096
	depends on FPBINJECT_EXEC_INHERIT_PRIORITY

config FPBINJECT_ENABLE_FPB
	bool "Enable FPB hardware"
	default y
	depends on ARCH_ARM && (ARCH_CORTEXM3 || ARCH_CORTEXM4 || ARCH_CORTEXM7 || ARCH_CORTEXM33 || ARCH_CORTEXM55)
	---help---
		Use the Cortex-M FPB. Not available, so off, on other targets.
		When off, the patch commands return FL_ERR_DISABLED.

config FPBINJECT_ENABLE_TRAMPOLINE
	bool "Enable trampoline mode (tpatch)"
	default y
	depends on FPBINJECT_ENABLE_FPB

config FPBINJECT_ENABLE_DEBUGMON
	bool "Enable DebugMonitor mode (dpatch)"
	default y
	depends on FPBINJECT_ENABLE_FPB

endif # FPBINJECT
```
